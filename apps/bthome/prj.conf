## CMakeLists.txt
```
cmake_minimum_required(VERSION 3.20.0)

set(HAPPYPOT_ROOT ${CMAKE_CURRENT_SOURCE_DIR}/../..)

# The board's drivers, shared with the Matter build. Merged after prj.conf, so it holds board
# facts only -- see the file's header.
list(APPEND EXTRA_CONF_FILE ${HAPPYPOT_ROOT}/conf/happypot_hw.conf)

# The firmware version -- one file, <repo>/VERSION, for both apps and the panel. Must precede
# find_package(Zephyr): that is what loads version.cmake.
include(${HAPPYPOT_ROOT}/cmake/happypot_version.cmake)

find_package(Zephyr REQUIRED HINTS $ENV{ZEPHYR_BASE})

project(HappyPot)

include(${HAPPYPOT_ROOT}/cmake/happypot_sources.cmake)

target_sources(app PRIVATE
	src/main.cpp
	src/bthome_adv.cpp
	${HAPPYPOT_LOOP_SOURCES}
	${HAPPYPOT_DEVICE_SOURCES}
)

# So main.cpp and bthome_adv.cpp resolve "sensors/..." and "ui/..." the way sources inside
# src/ do.
target_include_directories(app PRIVATE ${HAPPYPOT_INCLUDE_DIR})

# Header-only BTHome v2 payload builder (git submodule). Only this app speaks BTHome, so only
# this app sees the library.
target_include_directories(app PRIVATE ${HAPPYPOT_ROOT}/lib/bthome-cpp/src)
```

## prj.conf
```kconfig
# The BTHome firmware. Everything about the board -- drivers, console, UF2 output -- lives in
# conf/happypot_hw.conf, which the Matter build pulls in as well. What is left here is what only
# this build gets to decide.

# --- BLE / BTHome v2 broadcaster ---
CONFIG_BT=y
CONFIG_BT_BROADCASTER=y
CONFIG_BT_PERIPHERAL=n
CONFIG_BT_OBSERVER=n
CONFIG_BT_DEVICE_NAME="HappyPot"
# Extended advertising API (bt_le_ext_adv_*). We use it with legacy PDUs so the payload update
# (set_data) doesn't stall the SoC awake until the next event, the way legacy
# bt_le_adv_update_data does.
CONFIG_BT_EXT_ADV=y

# --- Low-power UART logging ---
# Immediate mode avoids periodic log-thread wakeups in sleep; the Matter build must NOT inherit
# this (an immediate 115200 console inside the CHIP thread stalls commissioning), which is why it
# is a per-app tunable and not a board fact.
CONFIG_LOG=y
CONFIG_PRINTK=n
CONFIG_LOG_BACKEND_UART=y
CONFIG_LOG_MODE_IMMEDIATE=y
CONFIG_LOG_PROCESS_THREAD=n

# With the LVGL workqueue off, the full-screen render runs on whichever thread calls
# lv_refr_now(): main (the boot splash) and the system workqueue (the measurement work). A
# 200x200 mono render + Montserrat-40 rasterization needs ~4 KB. (Default 1024 overflows -> MPU
# fault -> white panel + stuck SoC.)
CONFIG_MAIN_STACK_SIZE=4096
CONFIG_SYSTEM_WORKQUEUE_STACK_SIZE=4096

CONFIG_HEAP_MEM_POOL_SIZE=24576
CONFIG_LV_Z_MEM_POOL_SIZE=8192

# What the boot banner calls us; the NCS default is "My Application".
CONFIG_NCS_APPLICATION_BOOT_BANNER_STRING="HappyPot"
```

## app.overlay
```dts
/* One device, one description: everything lives in the shared .dtsi (which also pulls in the
 * flash map), so this build and the Matter build cannot drift apart. */
#include "../../dts/happypot_hw.dtsi"
```

## src/main.cpp
```c
#include "app.hpp"

#include "bthome_adv.hpp"

/** The BTHome firmware: install the radio's hooks, then run the device. */
int main(void)
{
	if (bthome_install() < 0)
	{
		return 0; // no radio is survivable; no device is not -- run() decides that
	}
	app::run("BTHome");
	return 0;
}
```

## src/bthome_adv.cpp
```c
#include "bthome_adv.hpp"

#include <string.h>

#include <bthome.h> // bthome-cpp library (lib/bthome-cpp/src)
#include <zephyr/bluetooth/bluetooth.h>
#include <zephyr/kernel.h>
#include <zephyr/logging/log.h>

#include "net.hpp"
#include "version.hpp"

LOG_MODULE_REGISTER(bthome, LOG_LEVEL_INF);

namespace
{
	bt_le_ext_adv *adv = nullptr;
	uint8_t packet_counter = 0;

	const uint8_t flags = BT_LE_AD_GENERAL | BT_LE_AD_NO_BREDR;

	/** Advertising interval in 0.625 ms units. Only matters for the spacing
	 * within a multi-event burst; with num_events=1 a single event goes out. */
	constexpr uint16_t ADV_INTERVAL = 160;

	/** The firmware version as BTHome's u24 (obj 0xF2): MAJOR.MINOR.PATCH.
	 * From <repo>/VERSION via Zephyr's app_version.h -- see src/version.hpp. */
	constexpr uint32_t FW_VERSION =
		(static_cast<uint32_t>(APP_VERSION_MAJOR) << 16) |
		(static_cast<uint32_t>(APP_VERSION_MINOR) << 8) |
		APP_PATCHLEVEL;

	/** Set the payload and emit exactly one advertising event (1 TX per primary
	 * channel), then the controller auto-stops. ext-adv set_data is non-blocking
	 * so the SoC sleeps right after the event. */
	int advertise_once(const bt_data *ad, size_t n)
	{
		int err = bt_le_ext_adv_set_data(adv, ad, n, nullptr, 0);
		if (err)
		{
			LOG_WRN("ext_adv_set_data failed (%d)", err);
			return err;
		}
		const bt_le_ext_adv_start_param start_param = {
			.timeout = 0,
			.num_events = 1,
		};
		err = bt_le_ext_adv_start(adv, &start_param);
		if (err)
		{
			LOG_WRN("ext_adv_start failed (%d)", err);
		}
		return err;
	}

	int publish(int moisture_percent, int32_t soil_mv, int32_t battery_mv, int battery_percent)
	{
		if (moisture_percent < 0)
		{
			moisture_percent = 0;
		}
		if (moisture_percent > 100)
		{
			moisture_percent = 100;
		}
		if (battery_percent < 0)
		{
			battery_percent = 0;
		}
		if (battery_percent > 100)
		{
			battery_percent = 100;
		}

		++packet_counter;

		BTHomePacket<31> packet;
		packet.add(BTHome::packet_id(packet_counter));
		packet.add(BTHome::moisture(static_cast<float>(moisture_percent)));
		packet.add(BTHome::battery(battery_percent));
		/** Both voltages always go in the same packet so a single advert carries the
		 * full reading: voltage = battery (V), voltage_c1 = soil ADC (V). */
		packet.add(BTHome::voltage(battery_mv / 1000.0f));
		packet.add(BTHome::voltage(soil_mv / 1000.0f));

		const bt_data svc = BT_DATA(BT_DATA_SVC_DATA16, packet.serviceData(),
									static_cast<uint8_t>(packet.serviceDataSize()));
		const bt_data flags_ad = BT_DATA(BT_DATA_FLAGS, &flags, sizeof(flags));

		/** Alternate the extra field only: odd (1st, 3rd, ...) -> name (no fw),
		 * even -> fw (no name). The 31-byte legacy advert can't hold both extras
		 * on top of the always-present measurements. */
		const bool with_name = (packet_counter % 2) == 1;
		if (!with_name)
		{
			packet.add(BTHome::firmware_version_u24(FW_VERSION));
		}
		else
		{

			const char *name = bt_get_name();
			const bt_data ad[] = {
				flags_ad,
				svc,
				BT_DATA(BT_DATA_NAME_COMPLETE, name, static_cast<uint8_t>(strlen(name))),
			};
			return advertise_once(ad, ARRAY_SIZE(ad));
		}

		const bt_data ad[] = {flags_ad, svc};
		return advertise_once(ad, ARRAY_SIZE(ad));
	}

	/** The net:: hook: unpack the cycle's reading into one advert. Runs on the loop's
	 * thread; advertise_once() is non-blocking, so the loop is never held up. */
	void reading_hook(const net::Reading &r)
	{
		(void)publish(r.soil.percent, r.soil.mv, r.battery.mv, r.battery.percent);
	}

} // namespace

int bthome_install(void)
{
	int err = bt_enable(nullptr);
	if (err)
	{
		LOG_ERR("bt_enable failed (%d)", err);
		return err;
	}

	/** Legacy PDU (no EXT_ADV opt) so phones/HA can read it, non-connectable,
	 * pinned to the stable identity address. */
	const bt_le_adv_param adv_param = BT_LE_ADV_PARAM_INIT(
		BT_LE_ADV_OPT_USE_IDENTITY,
		ADV_INTERVAL, ADV_INTERVAL, nullptr);
	err = bt_le_ext_adv_create(&adv_param, nullptr, &adv);
	if (err)
	{
		LOG_ERR("ext_adv_create failed (%d)", err);
		return err;
	}

	net::set_hooks({
		.reading = reading_hook,
		.factory_reset = nullptr, // a beacon has no network to leave
		.pairing_open = nullptr,  // and nothing to pair with
	});
	/* No QR, no manual code, no join hint: a BTHome receiver just listens. */
	net::set_radio({"BTHome", nullptr, nullptr, nullptr});

	LOG_INF("BT ready, BTHome v2 broadcaster");
	return 0;
}
```

## src/bthome_adv.hpp
```c
#pragma once

/** @file
 * BTHome v2 over BLE legacy advertising -- this build's radio.
 *
 * The one file that speaks Bluetooth. It installs itself into the net:: seam
 * (net::set_hooks / net::set_radio); the shared loop then publishes through
 * net::publish_reading() without knowing what a BTHome is.
 */

/** Bring BLE up, create the advertising set and install the net:: hooks.
 * Call before app::run().
 *
 * @retval 0 ready
 * @retval <0 bt_enable or advertising-set creation failed
 */
int bthome_install(void);
```
