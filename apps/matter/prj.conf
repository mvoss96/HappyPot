## CMakeLists.txt
```
cmake_minimum_required(VERSION 3.20.0)

set(HAPPYPOT_ROOT ${CMAKE_CURRENT_SOURCE_DIR}/../..)

# The board's drivers, shared with the BTHome firmware. Merged after prj.conf, so it holds
# board facts only -- see the file's header.
list(APPEND EXTRA_CONF_FILE ${HAPPYPOT_ROOT}/conf/happypot_hw.conf)

# conf/release.conf turns the logging off. It is opt-in on the command line rather than a switch
# here, because EXTRA_CONF_FILE has to be set before find_package(Zephyr), and zephyr_get() --
# the only thing that could read a sysbuild -D -- does not exist until after it:
#
#   west build -b promicro_nrf52840/nrf52840 apps/matter -d <dir> \
#       -- -Dmatter_EXTRA_CONF_FILE=<abs>/conf/release.conf
#
# The `matter_` prefix is how sysbuild routes a variable to this image rather than to itself.

# The firmware version -- one file, <repo>/VERSION, for both apps and the panel. Must precede
# find_package(Zephyr): that is what loads version.cmake.
include(${HAPPYPOT_ROOT}/cmake/happypot_version.cmake)

find_package(Zephyr HINTS $ENV{ZEPHYR_BASE})

project(happypot-matter)

# Enable GNU STD support.
include(${ZEPHYR_CONNECTEDHOMEIP_MODULE_DIR}/config/nrfconnect/app/enable-gnu-std.cmake)

# NORDIC SDK APP START

# Include all source files that are located in the Matter common directory.
include(${ZEPHYR_NRF_MODULE_DIR}/samples/matter/common/cmake/source_common.cmake)

# Include Data Model utils
include(${ZEPHYR_NRF_MODULE_DIR}/samples/matter/common/cmake/data_model.cmake)

include(${ZEPHYR_NRF_MODULE_DIR}/samples/matter/common/cmake/zap_helpers.cmake)
ncs_get_zap_parent_dir(ZAP_PARENT_DIR)

include(${HAPPYPOT_ROOT}/cmake/happypot_sources.cmake)

target_include_directories(app PRIVATE
  src
  ${ZAP_PARENT_DIR}
  ${HAPPYPOT_INCLUDE_DIR}
)

# This build's own main(): it brings Matter up and then hands the device to app::run(), which
# runs on a thread of its own alongside the CHIP event loop and OpenThread.
target_sources(app PRIVATE
  src/app_task.cpp
  src/main.cpp
)

# The device itself -- the same sources the BTHome firmware builds, minus its main().
target_sources(app PRIVATE
  ${HAPPYPOT_DEVICE_SOURCES}
  ${HAPPYPOT_LOOP_SOURCES}
)

ncs_configure_data_model()
# NORDIC SDK APP END
```

## Kconfig
```
mainmenu "HappyPot (Matter over Thread)"

choice OPENTHREAD_NORDIC_LIBRARY_CONFIGURATION
	default OPENTHREAD_NORDIC_LIBRARY_MTD
endchoice

choice OPENTHREAD_DEVICE_TYPE
	default OPENTHREAD_MTD
endchoice

config CHIP_ENABLE_ICD_SUPPORT
	default y

config CHIP_ICD_LIT_SUPPORT
	default y

config CHIP_ICD_SIT_SLOW_POLL_LIMIT
	default 5000

config CHIP_ICD_REPORT_ON_ACTIVE_MODE
	default y

# Reduce Thread TX output power to 0 dBm for SED device
config OPENTHREAD_DEFAULT_TX_POWER
	default 0

source "$(ZEPHYR_CONNECTEDHOMEIP_MODULE_DIR)/config/nrfconnect/chip-module/Kconfig.features"
source "$(ZEPHYR_CONNECTEDHOMEIP_MODULE_DIR)/config/nrfconnect/chip-module/Kconfig.defaults"
source "$(ZEPHYR_NRF_MODULE_DIR)/samples/matter/common/src/Kconfig"
source "Kconfig.zephyr"
```

## Kconfig.sysbuild
```
# The sample this is derived from defaulted the bootloader to MCUboot and turned on factory-data
# generation, DFU multi-image packaging and a network-core image -- all of it for boards we do
# not build or for a boot flow we deliberately do not use. HappyPot is a single-core nRF52840
# booting a plain image from the Adafruit UF2 bootloader. The switches that matter live in
# sysbuild.conf; everything else takes the upstream default.

source "share/sysbuild/Kconfig"
```

## sysbuild.conf
```
SB_CONFIG_MATTER=y
SB_CONFIG_PARTITION_MANAGER=n

# No MCUboot: plain single image at 0x1000, flashed via the Adafruit UF2 bootloader
# (keeps HappyPot's drag-drop field-update flow). Matter only imply's MCUboot, so this
# override is legal. Cost: no over-the-air OTA.
SB_CONFIG_BOOTLOADER_NONE=y

# No factory data -- using the built-in example attestation provider (see prj.conf).
SB_CONFIG_MATTER_FACTORY_DATA_GENERATE=n

# No over-the-air OTA (no MCUboot). This is what injects CONFIG_CHIP_OTA_REQUESTOR into
# the app image; off here drops the DFU image manager (IMG_MANAGER/DFU_TARGET/
# STREAM_FLASH) that needs slot0/slot1 partitions we don't have. Field updates are UF2.
SB_CONFIG_MATTER_OTA=n
```

## prj.conf
```kconfig
# Enable CHIP
CONFIG_CHIP=y
CONFIG_CHIP_PROJECT_CONFIG="src/chip_project_config.h"

# Configure ZAP file name
CONFIG_NCS_SAMPLE_MATTER_ZAP_FILE_PATH="${APPLICATION_CONFIG_DIR}/src/default_zap/happypot.zap"

# Device identity -- what a controller shows in its UI (Basic Information cluster). Left unset,
# every one of these falls back to a sample/test default. The serial is the same on every board
# we flash; per-device serials would need factory data, which we deliberately dropped (see
# CHIP_FACTORY_DATA_NONE below).
CONFIG_CHIP_DEVICE_VENDOR_NAME="HappyPot"
CONFIG_CHIP_DEVICE_PRODUCT_NAME="HappyPot Soil Sensor"
CONFIG_CHIP_DEVICE_HARDWARE_VERSION=1
CONFIG_CHIP_DEVICE_HARDWARE_VERSION_STRING="rev A"
CONFIG_CHIP_DEVICE_SERIAL_NUMBER="HAPPYPOT-0001"
# The software version comes from the VERSION file, not from here.

# 0x8000 (32768), to match the example attestation provider's DAC (FFF1-8000).
CONFIG_CHIP_DEVICE_PRODUCT_ID=32768
CONFIG_STD_CPP17=y

# Enable Matter pairing automatically on application start.
CONFIG_CHIP_ENABLE_PAIRING_AUTOSTART=y

# Enable Matter extended announcement and increase duration to 1 hour.
CONFIG_CHIP_BLE_EXT_ADVERTISING=y
CONFIG_CHIP_BLE_ADVERTISING_DURATION=60

# The DK library drives the buttons and LEDs of a Nordic development kit. We have neither: one
# button, no status LEDs, and that button already belongs to Zephyr's gpio-keys + input-longpress
# drivers (src/input/button.cpp). Two owners on one pin is not a style question -- the DK library
# takes raw GPIO callbacks and *disables the pin interrupt* while it debounces, which is the same
# interrupt gpio-keys is using. Off.
CONFIG_DK_LIBRARY=n

# Bluetooth Low Energy configuration. This name is the only one actually on the air during BLE
# commissioning -- the Matter commissionable payload carries no device name.
CONFIG_BT_DEVICE_NAME="HappyPot"
CONFIG_BT_DEVICE_NAME_MAX=18

# What the Zephyr/NCS boot banner calls us.
CONFIG_NCS_APPLICATION_BOOT_BANNER_STRING="HappyPot"

# How often the radio asks the router "anything for me?". We are a LIT ICD on paper, but the spec
# requires a LIT device to operate in SIT mode until some client registers via the ICD Management
# cluster, and nothing does -- so this SIT limit, not the 300 s slow-poll, is what the radio
# actually does. 15 s is the spec's ceiling and NCS's default; for a sensor that only ever
# reports, the added reachability latency costs nothing. (airInk measured ~11 mA a poll.)
CONFIG_CHIP_ICD_SIT_SLOW_POLL_LIMIT=15000

# Other settings
CONFIG_THREAD_NAME=y
CONFIG_MPU_STACK_GUARD=y
CONFIG_RESET_ON_FATAL_ERROR=n
# Shell off (saves flash; RAM barely).
CONFIG_CHIP_LIB_SHELL=n

# Reduce application size
CONFIG_USE_SEGGER_RTT=n

# Built-in example attestation provider: it ships a complete, self-consistent set -- DAC
# (FFF1/8000), PAI (FFF1), and a CD covering PID 0x8000 -- all hardcoded, no factory-data
# partition needed. With HA's enable_test_net_dcl=true the test certs are trusted.
#
# The passcode stays the well-known default 20202021 ON PURPOSE: the SPAKE2+ verifier is a
# STATIC Kconfig default that is NOT recomputed when the passcode changes, and a custom passcode
# with the stock verifier makes the commissioner's PASE check fail mid-BLE (airInk lost a day to
# exactly this). A custom passcode is a later two-liner: set CONFIG_CHIP_DEVICE_SPAKE2_PASSCODE
# and a CONFIG_CHIP_DEVICE_SPAKE2_TEST_VERIFIER regenerated for it (spake2p.py gen-verifier).
CONFIG_CHIP_FACTORY_DATA_NONE=y

# Matter has its own bootloader choice, separate from the sysbuild one, defaulting to
# CHIP_BOOTLOADER_MCUBOOT which hard-selects IMG_MANAGER. Pick NONE -- we have no MCUboot.
CONFIG_CHIP_BOOTLOADER_NONE=y

# NFC onboarding pulls in the NFC T2T nrfxlib, but the promicro board doesn't enable the nrfx
# NFCT driver -> undefined nrfx_nfct_* at link. We commission over BLE with the QR / manual code.
CONFIG_CHIP_NFC_ONBOARDING_PAYLOAD=n

# The board's drivers -- soil ADC, e-paper, LVGL, the button, the uart1 console, the UF2 output
# -- are not repeated here. They live in conf/happypot_hw.conf, shared with the BTHome firmware.
# Below is only what this build decides differently.
#
# The LVGL pool is a tuning knob, not a board fact. This build carries the pairing view, whose QR
# draw buffer is the pool's largest single allocation (airInk: 5 KB at 174 px; ours is 145 px).
# ui::log_pool() prints every view's cost at boot -- read those lines before adding a view or a
# font; running the pool dry is an MPU fault, not a graceful failure.
CONFIG_LV_Z_MEM_POOL_SIZE=16384

# --- Stacks. RAM is what this build is short of; every kilobyte here is one the UI cannot have.
# main() only runs the CHIP task queue (AppTask::StartApp); the 200x200 render with its 40 px
# glyph rasterisation moved to HappyPot's own thread, which is sized for it in app_task.cpp.
CONFIG_MAIN_STACK_SIZE=3072
# The CHIP event loop. Our cluster writes take the stack lock from HappyPot's thread rather than
# running here, so this carries Matter's own work only.
CONFIG_CHIP_TASK_STACK_SIZE=6144

# CHIP heap. The 10 KB default cannot build the NetworkCommissioning ScanNetworks response: the
# device returns NO_MEMORY, the commissioner stalls, the fail-safe expires and the fabric is
# rolled back. Home Assistant issues ScanNetworks during commissioning. Do not "reclaim" this.
CONFIG_CHIP_MALLOC_SYS_HEAP_SIZE=40960
```

## boards/promicro_nrf52840_nrf52840.overlay
```dts
/* One device, one description: everything lives in the shared .dtsi (which also pulls in the
 * flash map), so this build and the BTHome one cannot drift apart. */
#include "../../../dts/happypot_hw.dtsi"
```

## src/main.cpp
```c
#include "app_task.h"

#include <zephyr/logging/log.h>

LOG_MODULE_REGISTER(main, CONFIG_CHIP_APP_LOG_LEVEL);

int main()
{
	CHIP_ERROR err = AppTask::Instance().StartApp();

	LOG_ERR("Exited with code %" CHIP_ERROR_FORMAT, err.Format());
	return err == CHIP_NO_ERROR ? EXIT_SUCCESS : EXIT_FAILURE;
}
```

## src/app_task.cpp
```c
#include "app_task.h"

#include "app/matter_init.h"
#include "app/matter_event_handler.h"
#include "app/task_executor.h"
#include "clusters/identify.h"
#include "lib/core/CHIPError.h"

#include "app.hpp"
#include "app_config.hpp"
#include "net.hpp"

#include <app-common/zap-generated/attributes/Accessors.h>
#include <app/clusters/power-source-server/power-source-server.h>
#include <app/clusters/soil-measurement-server/soil-measurement-cluster.h>
#include <app/server/Server.h>
#include <data-model-providers/codegen/CodegenDataModelProvider.h>
#include <setup_payload/OnboardingCodesUtil.h>
#include <setup_payload/QRCodeSetupPayloadGenerator.h>

#include <zephyr/kernel.h>
#include <zephyr/logging/log.h>

LOG_MODULE_DECLARE(app, CONFIG_CHIP_APP_LOG_LEVEL);

using namespace ::chip;
using namespace ::chip::app; /* NB: this makes a bare `app::` ambiguous with HappyPot's own
				namespace -- reach for the latter as ::app:: */
using namespace ::chip::DeviceLayer;
using namespace ::chip::app::Clusters;

namespace
{
/* Endpoint map -- see src/default_zap/happypot.zap. One probe, one endpoint: the Soil Sensor
 * device type (0x0045, Matter 1.5) carries Identify + Descriptor + Soil Measurement (0x0430). */
constexpr EndpointId kPowerSourceEndpointId = 0; /* root node */
constexpr EndpointId kSensorEndpointId = 1;

/* The battery powers the whole node. */
EndpointId sPoweredEndpoints[] = { 0, 1 };

Nrf::Matter::IdentifyCluster sIdentifyCluster(kSensorEndpointId);

/* The Soil Measurement cluster is served by this code-driven DefaultServerCluster (the new
 * registry style -- there is no ember-backed storage for it, which is why the ZAP marks its
 * attributes "External"). Created and registered in the cluster's ember init callback below,
 * which fires while StartServer() configures the endpoints. */
LazyRegisteredServerCluster<SoilMeasurementCluster> sSoilCluster;

/* What the probe can OUTPUT: the full percent scale, with the probe's honest accuracy. */
const Globals::Structs::MeasurementAccuracyRangeStruct::Type kSoilAccuracyRanges[] = {
	{ .rangeMin = 0, .rangeMax = 100, .percentMax = MakeOptional(static_cast<chip::Percent100ths>(1000)) }
};

const SoilMeasurement::Attributes::SoilMoistureMeasurementLimits::TypeInfo::Type kSoilMeasurementLimits = {
	.measurementType = Globals::MeasurementTypeEnum::kSoilMoisture,
	.measured = true,
	.minMeasuredValue = 0,
	.maxMeasuredValue = 100,
	.accuracyRanges =
		DataModel::List<const Globals::Structs::MeasurementAccuracyRangeStruct::Type>(kSoilAccuracyRanges),
};

/* HappyPot's own thread. It renders a 200x200 mono frame with 40 px fonts and blocks ~3 s in an
 * e-paper refresh, so it gets the big stack -- and it gets it here rather than on the CHIP event
 * loop, which OpenThread needs responsive. Priority below the cooperative CHIP/OT threads. */
K_THREAD_STACK_DEFINE(sHappyPotStack, 8192);
k_thread sHappyPotThread;

/* The hook runs on HappyPot's thread, so it takes the CHIP stack lock -- the documented way to
 * touch cluster attributes from outside the event loop. Holding it across the setters keeps the
 * reading self-consistent for anyone reading it at that moment; none of them block. */
void PublishReading(const ::net::Reading &r)
{
	PlatformMgr().LockChipStack();

	/* Checked, because it can refuse (not yet registered, value out of range) -- and a soil
	 * number that quietly stops moving is worse than one that is missing. */
	if (sSoilCluster.IsConstructed()) {
		const CHIP_ERROR err = sSoilCluster.Cluster().SetSoilMoistureMeasuredValue(
			DataModel::MakeNullable(static_cast<chip::Percent>(r.soil.percent)));
		if (err != CHIP_NO_ERROR) {
			LOG_ERR("Soil %d %% was not published (%s)", r.soil.percent, err.AsString());
		}
	}

	/* The cell terminal voltage, in mV (batVoltage is int32u mV). Matter counts the battery
	 * in half percent. */
	PowerSource::Attributes::BatVoltage::Set(kPowerSourceEndpointId, r.battery.mv);
	PowerSource::Attributes::BatPercentRemaining::Set(kPowerSourceEndpointId,
							  static_cast<uint8_t>(r.battery.percent * 2));
	PowerSource::Attributes::BatChargeLevel::Set(
		kPowerSourceEndpointId, (r.battery.percent <= cfg::LOW_BATTERY_PCT)
						? PowerSource::BatChargeLevelEnum::kCritical
						: PowerSource::BatChargeLevelEnum::kOk);

	PlatformMgr().UnlockChipStack();
}

/* Runs on the CHIP thread; only records the state, the loop reads it on its next pass. */
void MatterEventHandler(const ChipDeviceEvent *event, intptr_t)
{
	if (event->Type == DeviceEventType::kThreadConnectivityChange) {
		::net::set_link_up(event->ThreadConnectivityChange.Result == kConnectivity_Established);
	}
}

/* Fabric membership, event-driven: committed and removed are the only two edges, and the fabric
 * table calls both on the CHIP thread. */
class FabricDelegate : public chip::FabricTable::Delegate {
	void OnFabricCommitted(const chip::FabricTable &table, FabricIndex) override
	{
		::net::set_commissioned(table.FabricCount() > 0);
	}
	void OnFabricRemoved(const chip::FabricTable &table, FabricIndex) override
	{
		::net::set_commissioned(table.FabricCount() > 0);
	}
};
FabricDelegate sFabricDelegate;

/* The onboarding codes, fetched once from CHIP. Static because net::set_radio() does not copy
 * them and the UI holds the pointers for the life of the device. */
char sQrCode[chip::QRCodeBasicSetupPayloadGenerator::kMaxQRCodeBase38RepresentationLength + 1];
char sManualCode[chip::kManualSetupLongCodeCharLength + 1];
char sManualCodePretty[sizeof(sManualCode) + 2]; /* room for the two dashes */

/* Group the manual code 4-3-4 as every controller UI does -- eleven bare digits are read wrong.
 * Only the 11-digit short code; anything unexpected passes through unmangled. */
const char *GroupManualCode(const char *digits)
{
	if (strlen(digits) != 11) {
		return digits;
	}
	snprintf(sManualCodePretty, sizeof(sManualCodePretty), "%.4s-%.3s-%.4s", digits, digits + 4,
		 digits + 7);
	return sManualCodePretty;
}

/* What a controller needs to find and authenticate this device -- the same payload the sample
 * prints to the log at boot, but printed on the e-paper, where the user actually is. It does not
 * change over the device's life, so read it once and hand it to the UI. */
void FetchOnboardingCodes()
{
	chip::MutableCharSpan qr(sQrCode);
	chip::MutableCharSpan manual(sManualCode);
	const chip::RendezvousInformationFlags rendezvous(chip::RendezvousInformationFlag::kBLE);

	if (GetQRCode(qr, rendezvous) != CHIP_NO_ERROR ||
	    GetManualPairingCode(manual, rendezvous) != CHIP_NO_ERROR) {
		LOG_ERR("Could not read the onboarding codes; no pairing screen");
		::net::set_radio({ "Matter over Thread", nullptr, nullptr, nullptr });
		return;
	}

	::net::set_radio({ "Matter over Thread", sQrCode, GroupManualCode(sManualCode), nullptr });
}

/* How long the radio listens after the user asks for the code: enough to fetch a phone, not the
 * boot window's full hour (CONFIG_CHIP_BLE_ADVERTISING_DURATION) -- that is right for a
 * factory-new device, too generous for a gesture. */
constexpr auto kPanelPairingWindow = System::Clock::Seconds32(10 * 60);

/* The code is on the panel: start listening, or the QR is a dead letter once the boot hour is
 * over. The two guards mirror Nordic's Board::StartBLEAdvertisement: a commissioned device must
 * not re-open (a second commissioner could join uninvited), and an already-advertising one must
 * not be restarted -- that would drop a PASE session seconds from completing. The second guard
 * also means a device inside its boot hour keeps the hour. Runs on HappyPot's thread; takes the
 * stack lock. */
void OpenPairingWindow()
{
	PlatformMgr().LockChipStack();

	if (Server::GetInstance().GetFabricTable().FabricCount() != 0) {
		LOG_INF("Already commissioned; not re-opening the window");
	} else if (ConnectivityMgr().IsBLEAdvertisingEnabled()) {
		LOG_INF("Commissioning window already open");
	} else if (Server::GetInstance().GetCommissioningWindowManager().OpenBasicCommissioningWindow(
			   kPanelPairingWindow) != CHIP_NO_ERROR) {
		LOG_ERR("Could not open the commissioning window");
	} else {
		LOG_INF("Commissioning window opened from the panel for %u s",
			kPanelPairingWindow.count());
	}

	PlatformMgr().UnlockChipStack();
}

/* The user held the button on a confirmation screen that said what this does. CHIP wipes the
 * fabrics and reboots; it schedules the work rather than doing it here, because we are on
 * HappyPot's thread and the storage belongs to the CHIP one. */
void FactoryReset()
{
	LOG_INF("Factory reset requested from the panel");
	Server::GetInstance().ScheduleFactoryReset();
}

void HappyPotThread(void *, void *, void *)
{
	const ::net::Hooks hooks = {
		.reading = PublishReading,
		.factory_reset = FactoryReset,
		.pairing_open = OpenPairingWindow,
	};
	::net::set_hooks(hooks);
	::app::run("Matter over Thread"); /* never returns */
}

} /* namespace */

/* Fires from Server::Init() -> emberAfEndpointConfigure() while StartServer() runs -- the moment
 * the registry exists for this endpoint. Overrides the ZAP-generated weak stub. */
void emberAfSoilMeasurementClusterInitCallback(EndpointId endpoint)
{
	if (endpoint != kSensorEndpointId) {
		LOG_ERR("Soil Measurement on unexpected endpoint %u", endpoint);
		return;
	}

	sSoilCluster.Create(endpoint, kSoilMeasurementLimits);

	const CHIP_ERROR err =
		CodegenDataModelProvider::Instance().Registry().Register(sSoilCluster.Registration());
	if (err != CHIP_NO_ERROR) {
		LOG_ERR("Soil Measurement cluster registration failed (%s)", err.AsString());
		return;
	}

	/* Null until the first real sample: "no measurement yet" is the honest boot state. */
	sSoilCluster.Cluster().SetSoilMoistureMeasuredValue(
		DataModel::Nullable<chip::Percent>());
}

CHIP_ERROR AppTask::Init()
{
	ReturnErrorOnFailure(Nrf::Matter::PrepareServer());
	ReturnErrorOnFailure(Nrf::Matter::RegisterEventHandler(MatterEventHandler, 0));
	ReturnErrorOnFailure(sIdentifyCluster.Init());
	ReturnErrorOnFailure(Nrf::Matter::StartServer());

	/* Only now: the ember endpoint tables exist once StartServer() has returned (the soil
	 * cluster registered itself from the init callback above, mid-StartServer). The event
	 * loop is live by now, so take the stack lock. */
	PlatformMgr().LockChipStack();
	PowerSourceServer::Instance().SetEndpointList(kPowerSourceEndpointId,
						      Span<EndpointId>(sPoweredEndpoints));
	PlatformMgr().UnlockChipStack();

	return CHIP_NO_ERROR;
}

CHIP_ERROR AppTask::StartApp()
{
	ReturnErrorOnFailure(Init());

	/* Before the thread starts: app::run() reads the codes when it builds the UI, and whether
	 * there are any is what decides that the menu has a Network row at all. The fabric table
	 * has been loaded from NVS by now, so the seed below is the state a reboot comes back to;
	 * the delegate keeps it current from there. */
	FetchOnboardingCodes();
	Server::GetInstance().GetFabricTable().AddFabricDelegate(&sFabricDelegate);
	::net::set_commissioned(Server::GetInstance().GetFabricTable().FabricCount() > 0);

	k_thread_create(&sHappyPotThread, sHappyPotStack, K_THREAD_STACK_SIZEOF(sHappyPotStack),
			HappyPotThread, nullptr, nullptr, nullptr, K_PRIO_PREEMPT(10), 0, K_NO_WAIT);
	k_thread_name_set(&sHappyPotThread, "happypot");

	while (true) {
		Nrf::DispatchNextTask();
	}

	return CHIP_NO_ERROR;
}
```

## src/app_task.h
```c
#pragma once

#include <platform/CHIPDeviceLayer.h>

/** Brings up Matter, then hands the device itself to HappyPot.
 *
 * StartApp() runs the CHIP task queue on the main thread forever. Everything HappyPot does --
 * the panel, the probe, the button, the menu -- runs on a thread of its own (app::run(), see
 * src/app.hpp), because an e-paper refresh blocks for ~3 s, and it may not sit on the CHIP
 * event loop while OpenThread waits to poll its parent.
 *
 * Direction of travel: HappyPot measures, and hands each reading to Matter. Matter never
 * reaches back into the UI -- the network state is left where the loop picks it up
 * (net::set_link_up(), net::set_commissioned()).
 */
class AppTask {
public:
	static AppTask &Instance()
	{
		static AppTask sAppTask;
		return sAppTask;
	};

	CHIP_ERROR StartApp();

private:
	CHIP_ERROR Init();
};
```

## src/chip_project_config.h
```c
/**
 *    @file
 *          Project configuration overrides for CHIP.
 */

#pragma once

/**
 * Include a device name in the commissionable-node advertisement. Off by default, which is
 * why a commissioner has nothing to call the device before it can read Basic Information
 * and shows a generic placeholder ("Matter Accessory" in Home Assistant). Note this only
 * populates the DNS-SD commissionable record; over BLE the name a scanner sees is
 * CONFIG_BT_DEVICE_NAME. Whether a given controller surfaces either is up to the controller.
 */
#define CHIP_DEVICE_CONFIG_ENABLE_COMMISSIONABLE_DEVICE_NAME 1
#define CHIP_DEVICE_CONFIG_DEVICE_NAME "HappyPot"
```
